## samples/open_amp/cm7/Kconfig.sysbuild
```kconfig
# Copyright 2022-2025 NXP
#
# SPDX-License-Identifier: Apache-2.0

source "share/sysbuild/Kconfig"

config OPENAMP_REMOTE_BOARD
string
	default "mimxrt1160_evk/mimxrt1166/cm4" if $(BOARD) = "mimxrt1160_evk"
```

## west-manifest/west.yml
```yaml
manifest:
  remotes:
    - name: zephyrproject
      url-base: https://github.com/zephyrproject-rtos

  projects:
    - name: zephyr
      remote: zephyrproject
      revision: v4.1.0
      clone-depth: 1
      import:
        path-prefix: 3rd_parties/zephyr
        name-allowlist:
          - cmsis
          - cmsis-dsp
          - picolibc
          - segger
          - hal_nxp
          - open-amp
          - libmetal

    # Manually specified external modules (remain outside default module layout)
    - name: open-amp
      path: 3rd_parties/open-amp
      remote: zephyrproject
      revision: main

    - name: libmetal
      path: 3rd_parties/libmetal
      remote: zephyrproject
      revision: main

    - name: mbedtls
      path: 3rd_parties/mbedtls
      remote: zephyrproject
      revision: zephyr

    - name: mcuboot
      path: 3rd_parties/mcuboot
      remote: zephyrproject
      revision: v1.10.0

    - name: fatfs
      path: 3rd_parties/fatfs
      remote: zephyrproject
      revision: master

  self:
    path: .
```
